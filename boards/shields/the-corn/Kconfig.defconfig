## boards/shields/the-corn/Kconfig.defconfig
```kconfig
if SHIELD_THE_CORN_DONGLE

config ZMK_KEYBOARD_NAME
    default "the_corn"

config ZMK_SPLIT_TOLE_CENTRAL
    default y

config ZMK_SPLIT
    default y

config ZMK_SPLIT_BLE_CENTRAL_PERIPHERALS
    default 1

config BT_MAX_CONN
    default 5

config BT_MAX_PAIRED
    default 5

endif
```

## boards/shields/the-corn/Kconfig.shield
```kconfig
config SHIELD_THE_CORN_DONGLE
    def_bool $(shields_list_contains,the_corn_dongle)
```
